## jobs/2284/meta-mbl-dev/conf/bblayers.conf
```bitbake
# LAYER_CONF_VERSION is increased each time build/conf/bblayers.conf
# changes incompatibly
LCONF_VERSION = "7"

OEROOT := "${@os.path.abspath(os.path.dirname(d.getVar('FILE', True)))}/../../.."

BBLAYERS += " \
  ${OEROOT}/layers/meta-mbl-dev \
"
```

## jobs/2284/meta-mbl-dev/conf/layer.conf
```bitbake
# Copyright (c) 2018 Arm Limited and Contributors. All rights reserved.
#
# SPDX-License-Identifier: MIT

# mbed linux layer configuration file
BBPATH .= ":${LAYERDIR}"

# We have a recipes directory, add to BBFILES
BBFILES += "${LAYERDIR}/recipes*/*/*.bb ${LAYERDIR}/recipes*/*/*.bbappend"

BBFILE_COLLECTIONS += "meta-mbl-dev"
BBFILE_PATTERN_meta-mbl-dev := "^${LAYERDIR}/"
BBFILE_PRIORITY_meta-mbl-dev = "14"
LAYERSERIES_COMPAT_meta-mbl-dev = "sumo thud"

# Upstream the following fixes for WARNINGS
LAYERSERIES_COMPAT_raspberrypi = "sumo thud"
```
